/*
 * d3434.c
 *
 * Created: 2022.10.31
 * Author: zongqiao.pei
 */
#include "dlp_manager.h"
#include "utils.h"
#include "stdio.h"

struct pic_def *pic_pos;


#include "stdint.h"


static const unsigned char  g_sCRCHI[] = {
    0x00, 0xC1, 0x81, 0x40, 0x01, 0xC0, 0x80, 0x41, 0x01, 0xC0, 0x80, 0x41,
    0x00, 0xC1, 0x81, 0x40, 0x01, 0xC0, 0x80, 0x41, 0x00, 0xC1, 0x81, 0x40,
    0x00, 0xC1, 0x81, 0x40, 0x01, 0xC0, 0x80, 0x41, 0x01, 0xC0, 0x80, 0x41,
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    0x00, 0xC1, 0x81, 0x40
};
static const  unsigned char g_sCRCLO[] = {
    0x00, 0xC0, 0xC1, 0x01, 0xC3, 0x03, 0x02, 0xC2, 0xC6, 0x06, 0x07, 0xC7,
    0x05, 0xC5, 0xC4, 0x04, 0xCC, 0x0C, 0x0D, 0xCD, 0x0F, 0xCF, 0xCE, 0x0E,
    0x0A, 0xCA, 0xCB, 0x0B, 0xC9, 0x09, 0x08, 0xC8, 0xD8, 0x18, 0x19, 0xD9,
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    0x41, 0x81, 0x80, 0x40
};
/**IchispsDataStorage CRC????

  **/
uint16_t crcChecksum(uint8_t *data, uint16_t len)
{
    unsigned char ucCRCHi = 0xFF;
    unsigned char ucCRCLo = 0xFF;
    unsigned int iIndex;
    while (len--) {

        iIndex = ucCRCLo ^ *(data++);
        ucCRCLo = (unsigned char)(ucCRCHi ^ g_sCRCHI[iIndex]);
        ucCRCHi = g_sCRCLO[iIndex];
    }
    return (uint16_t)(ucCRCHi << 8 | ucCRCLo);
}

void pic_add(pic_handle handle)
{
 	struct pic_def *pic = malloc(sizeof(struct pic_def));
	pic->handle = handle;
	if (pic_pos) {
 		list_add_tail(&(pic->qset), &(pic_pos->qset));
	} else {
		pic_pos = pic;
		init_list_head(&(pic_pos->qset));
	}
}

//void pic_next()
//{
//	pic_pos = list_next_entry(pic_pos, qset);
//	pic_pos->handle();
//}

//void pic_prev()
//{
//	pic_pos = list_prev_entry(pic_pos, qset);
//	pic_pos->handle();
//}

//static uint32_t htonl(uint32_t value)
//{
	//return ((value & 0x000000FF) << 24) |  ((value & 0x0000FF00) << 8) |  ((value & 0x00FF0000) >> 8) | ((value & 0xFF000000) >> 24);
//}

struct trans_data {
	uint8_t sub_addr;
	uint32_t value;
};

#if defined(P3EM) || defined(P2NHD)
int8_t write_dlp(uint8_t sub_addr, uint32_t value)
{
	LedOn(SDA_PORT,SDA_PIN);
	LedOn(SCL_PORT,SCL_PIN);
	struct trans_data d;
	d.sub_addr = sub_addr;
	d.value = htonl(value);
	bool ret = i2c_write_block(0x36, sizeof(d), 0, &d);
	return ret;
}
#endif

#if defined(P23_720p) || defined(P23_540p) || defined(P33) || defined(P47)
int8_t write_dlp(uint8_t sub_addr,volatile uint8_t *value, uint8_t len)
{
	io_set_dir_out(SDA_PORT,SDA_PIN);
	io_set_dir_out(SCL_PORT,SCL_PIN);
	uint8_t d[13];
	d[0] = sub_addr;
	memcpy(&d[1], value, len);
	bool ret = i2c_write_block(0x36, len+1, 0, d);
	return ret;
}
#endif

#if defined (P3EM) ||  defined(P2NHD)
int8_t read_dlp(uint8_t sub_addr,uint8_t *data)
{
	int8_t ret = _SUCCESS;
	uint8_t d[2];
	d[0] = 0x15;
	d[1] = sub_addr;
	ret = i2c_write_block(0x36, sizeof(d), 0, d);
	if (ret != _SUCCESS) {
		return ret;
	}
	ret = i2c_read_block(0x37, 4, data);
	if (ret != _SUCCESS) {
		return ret;
	}
	*(uint32_t*)data = htonl(*(uint32_t*)data);
	return ret;
}

#endif

#if defined(P33) || defined(P47) || defined(P23_720p) || defined(P23_540p)
int8_t read_dlp(uint8_t sub_addr, uint8_t *param,
				uint8_t para_len,volatile uint8_t *data,
				uint8_t data_len)
{
	uint8_t ret;
	uint8_t d_len = sizeof(sub_addr) + para_len;
	uint8_t *d = malloc(d_len);
	d[0] = sub_addr;
	memcpy(d+sizeof(sub_addr), param, para_len);
	i2c_write_block(0x36, d_len, 0, d);
	__delay_ms(10);
	 //i2c_read_block(0x37, data_len, data);
    ret = i2c_read_block(0x37, data_len, data);
	free(d);
	return ret;
}
#endif

void set_rgbcurrent(uint16_t r, uint16_t g, uint16_t b)
{
	uint8_t d[6];
	
	memcpy(&d[0], &r, 2);
	memcpy(&d[2], &g, 2);
	memcpy(&d[4], &b, 2);
	safe_write(0x5c, d, 6); //max current
	safe_write(0x54, d, 6); //led current
}

#if defined(P47) || defined(P33) || defined(P23_720p) || defined(P23_540p)
static void dmd_training_check()
{
	uint8_t param[1];
	uint8_t data[11];
	bool err = false;

	for (uint8_t i=0; i<8; i++) {
		param[0] = i;
		read_dlp(0xdc, param, sizeof(param), data, sizeof(data));
		if (data[0] & BIT5) {
			err = true;
			break;
			} else {
			if ((data[3]&0x3f)-(data[2]&0x3f) <= 12) {
				err = true;
				break;
			}
		}
	}
	if (err) {
		pattern_magenta();
		} else {
		pattern_white();
	}
	return ;
}
#endif

void dlp_init(void)
{
	uint8_t status;
	#if defined(P3EM)
	//rest -> PB0 , ?????????100ms????????
	//proj -> PC13
	reset:	__delay_ms(200);

	while (write_dlp(0x39, 0x0c) != _SUCCESS) {
		__delay_ms(500);
		PORTB_set_pin_dir(3, PORT_DIR_OUT);
		PORTB_set_pin_dir(0, PORT_DIR_OUT);
		PORTB_set_pin_level(3, 0);
		PORTB_set_pin_level(0, 0);
		__delay_ms(50);
		PORTB_set_pin_level(0, 1);
		__delay_ms(10);
		PORTB_set_pin_level(3, 1);
		__delay_ms(350);
	}
	//write_dlp(0x39, 0x0c);
	write_dlp(0x3a, 0x01);
	write_dlp(0x38, 0xd0);
	write_dlp(0x3a, 0x01);
	write_dlp(0x38, 0xd1);
	read_dlp(0x39, (uint8_t *)&status);

	write_dlp(0x0b, 0x00);
	write_dlp(0x12, 0x3ff);
	write_dlp(0x13, 0x3ff);
	write_dlp(0x14, 0x3ff);
	write_dlp(0x39, 0x01);
	write_dlp(0x3a, 0x01);
	write_dlp(0x38, 0xd3);
	write_dlp(0x0f, 0x00);
	write_dlp(0x10, 0x01);
	write_dlp(0x0c, 0x15);
	write_dlp(0x16, 0x07);

	write_dlp(0x0b, 0x02);	//splash
	write_dlp(0x39, 0x00);
	write_dlp(0x3a, 0x01);
	write_dlp(0x38, 0xbd);


	source_external();
	//write_dlp(DLP_CMD_TEST_PATTERN, 0x02);

	//write_dlp(0x0c, 0x15);
	//write_dlp(DLP_CMD_INPUT_SOURCE, 0x00);0
	#endif

	#if defined(P2NHD)
	//__delay_ms(500);
	PORTB_set_pin_dir(3, PORT_DIR_OUT);
	PORTB_set_pin_dir(0, PORT_DIR_OUT);
	PORTB_set_pin_level(3, 0);
	PORTB_set_pin_level(0, 0);
	__delay_ms(500);
	PORTB_set_pin_level(0, 1);
	__delay_ms(600);
	PORTB_set_pin_level(3, 1);
	__delay_ms(150);
	while (write_dlp(0x0b, 0x00) != _SUCCESS) __delay_ms(500);
	#endif

	#if defined(P33)
	PORTB_set_pin_dir(0, PORT_DIR_OUT);
	PB0_set_level(false);
	
	PORTB_set_pin_dir(2, 1);	//BP PWM
	PORTC_set_pin_dir(1, 1);	//BP EN
	PORTB_set_pin_dir(3, 1);	//proj  设置为输出

	uint8_t cnt=3;
	while(cnt--){
		if (!power_on() ) {
			__delay_ms(100);
			power_off();
			__delay_ms(1000);
			} else {
			pic_init();
			pattern_white();
			break;
		}
	}

	#endif

	#if defined(P47)
	int i = 0;
	reset:
	    __delay_ms(700);
		uint8_t d[13];



//	/* r736 g984 b984 */
	uint8_t b[2];
	b[0] = 0x05;
	b[1] = 0x01;

    __delay_ms(700);
	i2c_write_block(0x36, 2, 0, b);


	__delay_ms(100);

	uint8_t c[2];
	c[0] = 0x52;
	c[1] = 0x07;

	i2c_write_block(0x36, 2, 0, c);


////////	/* r736 g984 b984 */



//////  __delay_ms(100);	
//////	set_current(0);
//////	__delay_ms(100);
//////	pattern_white();

//////	__delay_ms(100);
//////	set_led(true);

//////	__delay_ms(100);	
//////	pic_init();
//////	pattern_white();
//////	
//////	__delay_ms(100);
//////	dmd_training_check();
//////	
//////	__delay_ms(100);
	//__delay_ms(1000);
	#endif

	#if defined(P23_720p)  //G10  使用整机的系统�

	PORTB_set_pin_dir(0, PORT_DIR_OUT);
	PB0_set_level(false);   //振镜不供电�
	
	//BP PWM
	PORTB_set_pin_dir(2, 1);	//高低电平控制
	//set_bp_LED_current(33);	//PWM输出控制		//bp_LED电流设置为3.4A交流
	PORTC_set_pin_dir(1, 1);	//BP EN

	PORTB_set_pin_dir(3, PORT_DIR_OUT);	
	PORTB_set_pin_level(3, 1);	//proj on
	PORTC_set_pin_dir(2, PORT_DIR_OUT);
	PORTC_set_pin_level(2, 1);
//等整机启动完成，然后切换IIC到单片机控制
	__delay_ms(3000);
	PORTC_set_pin_level(2, 0);
	__delay_ms(1000);
	
	power_off();
	__delay_ms(2000);
	
	if (!power_on()) {
		__delay_ms(100);
	  	power_off();
		//__delay_ms(1000);
		} else {
		pic_init();
		pattern_white();
	}
	front_splash();
	=
	#endif

	#if defined(P23_540p)  //G07  使用整机的系统�
	PORTB_set_pin_dir(2, 1);	//BP PWM
	PORTC_set_pin_dir(1, 1);	//BP EN

	PORTB_set_pin_dir(3, PORT_DIR_OUT);
	PORTB_set_pin_level(3, 0);	//proj on	
	PORTB_set_pin_level(3, 1);	//proj on
	PORTC_set_pin_dir(2, PORT_DIR_OUT);
	PORTC_set_pin_level(2, 1);
//等整机启动完成，然后切换IIC到单片机控制
	__delay_ms(3000);
	PORTC_set_pin_level(2, 0);
	__delay_ms(1000);
	
	power_off();
	__delay_ms(2000);
		
	if (!power_on()) {
		__delay_ms(100);
		power_off();
		//__delay_ms(1000);
	} else {
		pic_init();
		pattern_white();
	}
	#endif

}
